## packages/bench/sdkconfig.defaults
```kconfig
# SPDX-License-Identifier: APACHE-2.0
# SPDX-FileCopyrightText: 2026 Nirapod Contributors

CONFIG_COMPILER_OPTIMIZATION_SIZE=y
CONFIG_ESP32_DEFAULT_CPU_FREQ_240=y
CONFIG_ESP32_DEFAULT_CPU_FREQ_MHZ=240
# CONFIG_PM_ENABLE is not set
# CONFIG_FREERTOS_USE_TICKLESS_IDLE is not set
```

## packages/core/Kconfig
```kconfig
# SPDX-License-Identifier: APACHE-2.0
# SPDX-FileCopyrightText: 2026 Nirapod Contributors
#
# Kconfig options for nirapod-bip39.

menu "nirapod-bip39"

config NIRAPOD_BIP39
    bool "Enable nirapod-bip39"
    default y

config NIRAPOD_BIP39_BACKEND_5BIT
    bool "Use the 5-bit packed backend"
    depends on NIRAPOD_BIP39
    default y

config NIRAPOD_BIP39_BACKEND_TRIE
    bool "Use the packed radix trie backend"
    depends on NIRAPOD_BIP39
    default n

config NIRAPOD_BIP39_BACKEND_DAWG
    bool "Use the DAWG backend"
    depends on NIRAPOD_BIP39
    default n

endmenu
```

## packages/core/bench/sdkconfig.defaults
```kconfig
# SPDX-License-Identifier: APACHE-2.0
# SPDX-FileCopyrightText: 2026 Nirapod Contributors

CONFIG_COMPILER_OPTIMIZATION_SIZE=y
```
